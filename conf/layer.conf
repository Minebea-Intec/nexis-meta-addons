## conf/layer.conf
```bitbake
# We have a conf directory, append to BBPATH
BBPATH .= ":${LAYERDIR}"

# We have a recipes directory, add to BBFILES
BBFILES += "${LAYERDIR}/recipes-*/*/*.bb ${LAYERDIR}/recipes-*/*.bb ${LAYERDIR}/recipes*/*/*.bbappend"

BBFILE_COLLECTIONS += "addons"
BBFILE_PATTERN_addons := "^${LAYERDIR}/"
BBFILE_PRIORITY_addons = "6"

LAYERSERIES_COMPAT_addons := "thud"
```

## sdk/Docker/conf/bblayers.conf
```bitbake
# POKY_BBLAYERS_CONF_VERSION is increased each time build/conf/bblayers.conf
# changes incompatibly
POKY_BBLAYERS_CONF_VERSION = "2"

BBPATH = "${TOPDIR}"
BBFILES ?= ""

BBLAYERS ?= " \
  /home/docker/nexis/sources/poky/meta \
  /home/docker/nexis/sources/poky/meta-poky \
  /home/docker/nexis/sources/poky/meta-yocto-bsp \
  /home/docker/nexis/sources/meta-openembedded/meta-oe \
  /home/docker/nexis/sources/meta-openembedded/meta-python \
  /home/docker/nexis/sources/meta-openembedded/meta-networking \
  /home/docker/nexis/sources/meta-openembedded/meta-webserver \
  /home/docker/nexis/sources/meta-swupdate \
  /home/docker/nexis/sources/meta-freescale \
  /home/docker/nexis/sources/meta-fsl-demos \
  /home/docker/nexis/sources/meta-digi/meta-digi-arm \
  /home/docker/nexis/sources/meta-digi/meta-digi-dey \
  /home/docker/nexis/sources/meta-addons-nexis \
  "
LAYERDEPENDS_digi-dey_remove = " qt5-layer "
TOOLCHAIN_HOST_TASK_append = " nativesdk-luajit "
```
